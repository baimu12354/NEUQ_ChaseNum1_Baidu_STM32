#include "ChaseNum1_Include.h"


void TS_TFT180_init(void){
    printf("Debug: Enter TS_TFT180_init\n");
    TS_Hard_SPI_init();
    printf("Debug: SPI Hardware Init Done\n");
    tft180_init();
    printf("Debug: tft180_init Logic Done\n"); // 3. 确认屏幕逻辑初始化完成
    tft180_show_string(0, 0, "ChaseNum1");

    
}


const uint8_t ascii_font_8x16[][16];
const uint8_t ascii_font_6x8[][6];

uint16_t                   tft180_width_max    = 128;
uint16_t                   tft180_height_max   = 160;
static 	uint16_t                   tft180_pencolor     = TFT180_DEFAULT_PENCOLOR;          // 画笔颜色(字体色)
static 	uint16_t                   tft180_bgcolor      = TFT180_DEFAULT_BGCOLOR;           // 背景颜色

static 	tft180_dir_enum          tft180_display_dir  = TFT180_DEFAULT_DISPLAY_DIR;       // 显示方向
static 	tft180_font_size_enum    tft180_display_font = TFT180_DEFAULT_DISPLAY_FONT;      // 显示字体类型

#define func_abs(x) ((x) > 0 ? (x) : -(x))

void spi_write_8bit(uint8_t data)
{
    // 发送一个字节数据
    HAL_SPI_Transmit(&Hard_SPI_2_Handle, &data, 1, HAL_MAX_DELAY);
}

void spi_write_8bit_array(const uint8_t *data, uint16_t len)
{
    // 发送多个字节数据
    HAL_SPI_Transmit(&Hard_SPI_2_Handle, (uint8_t *)data, len, HAL_MAX_DELAY);
}

void spi_write_16bit(uint16_t data)
{
    // 发送一个字节数据
    uint8_t buffer[2];
    buffer[0] = (data >> 8) & 0xFF; // 高字节
    buffer[1] = data & 0xFF;        // 低字节
    HAL_SPI_Transmit(&Hard_SPI_2_Handle, buffer, 2, HAL_MAX_DELAY);
}

void spi_write_16bit_array(const uint16_t *data, uint16_t len)
{
    // 发送多个字节数据
    HAL_SPI_Transmit(&Hard_SPI_2_Handle, (uint8_t *)data, len * 2, HAL_MAX_DELAY);
}


//-------------------------------------------------------------------------------------------------------------------
// 函数简介     TFT180 SPI 写 8bit 数据
// 参数说明     data            数据
// 返回参数     void
// 使用示例     tft180_write_8bit_data(dat);
// 备注信息     内部调用
//-------------------------------------------------------------------------------------------------------------------
#define tft180_write_8bit_data(data)                (spi_write_8bit((data)))

//-------------------------------------------------------------------------------------------------------------------
// 函数简介     TFT180 SPI 写 8bit 数据数组
// 参数说明     *data           数据
// 参数说明     len             数据长度
// 返回参数     void
// 使用示例     tft180_write_8bit_data_array(data, len);
// 备注信息     内部调用
//-------------------------------------------------------------------------------------------------------------------
#define tft180_write_8bit_data_array(data, len)     (spi_write_8bit_array((data), (len)))

//-------------------------------------------------------------------------------------------------------------------
// 函数简介     TFT180 SPI 写 16bit 数据
// 参数说明     data            数据
// 返回参数     void
// 使用示例     ips114_write_16bit_data(x1 + 52);
// 备注信息     内部调用
//-------------------------------------------------------------------------------------------------------------------
#define tft180_write_16bit_data(data)               (spi_write_16bit((data)))

//-------------------------------------------------------------------------------------------------------------------
// 函数简介     TFT180 SPI 写 16bit 数据数组
// 参数说明     *data           数据
// 参数说明     len             数据长度
// 返回参数     void
// 使用示例     tft180_write_16bit_data_array(data, len);
// 备注信息     内部调用
//-------------------------------------------------------------------------------------------------------------------
#define tft180_write_16bit_data_array(data, len)    (spi_write_16bit_array((data), (len)))

//-------------------------------------------------------------------------------------------------------------------
// 函数简介     写命令
// 参数说明     dat             数据
// 返回参数     void
// 使用示例     tft180_write_index(0x2a);
// 备注信息     内部调用
//-------------------------------------------------------------------------------------------------------------------
static void tft180_write_index (const uint8_t dat)
{
    TFT180_DC(0);
    tft180_write_8bit_data(dat);
    TFT180_DC(1);
}

//-------------------------------------------------------------------------------------------------------------------
// 函数简介     设置显示区域 内部调用
// 参数说明     x1              起始x轴坐标
// 参数说明     y1              起始y轴坐标
// 参数说明     x2              结束x轴坐标
// 参数说明     y2              结束y轴坐标
// 返回参数     void
// 使用示例     tft180_set_region(0, 0, tft180_width_max - 1, tft180_height_max - 1);
// 备注信息     内部调用
//-------------------------------------------------------------------------------------------------------------------
static void tft180_set_region (uint16_t x1, uint16_t y1, uint16_t x2, uint16_t y2)
{


    switch(tft180_display_dir)
    {
        case TFT180_PORTAIT:
        case TFT180_PORTAIT_180:
        {
            tft180_write_index(0x2a);
            tft180_write_8bit_data(0x00);
            tft180_write_8bit_data(x1 + 2);
            tft180_write_8bit_data(0x00);
            tft180_write_8bit_data(x2 + 2);

            tft180_write_index(0x2b);
            tft180_write_8bit_data(0x00);
            tft180_write_8bit_data(y1 + 1);
            tft180_write_8bit_data(0x00);
            tft180_write_8bit_data(y2 + 1);
        }break;
        case TFT180_CROSSWISE:
        case TFT180_CROSSWISE_180:
        {
            tft180_write_index(0x2a);
            tft180_write_8bit_data(0x00);
            tft180_write_8bit_data(x1 + 1);
            tft180_write_8bit_data(0x0);
            tft180_write_8bit_data(x2 + 1);

            tft180_write_index(0x2b);
            tft180_write_8bit_data(0x00);
            tft180_write_8bit_data(y1 + 2);
            tft180_write_8bit_data(0x00);
            tft180_write_8bit_data(y2 + 2);
        }break;
    }
    tft180_write_index(0x2c);
}

//-------------------------------------------------------------------------------------------------------------------
// 函数简介     TFT180 清屏函数
// 参数说明     void
// 返回参数     void
// 使用示例     tft180_clear();
// 备注信息     将屏幕清空成背景颜色
//-------------------------------------------------------------------------------------------------------------------
void tft180_clear (void)
{
    uint16_t color_buffer[160];
    uint16_t i = 0, j = 0;

    TFT180_CS(0);
    tft180_set_region(0, 0, tft180_width_max - 1, tft180_height_max - 1);
    for(i = 0; i < tft180_width_max; i ++)
    {
        color_buffer[i] = tft180_bgcolor;
    }
    for (j = 0; j < tft180_height_max; j ++)
    {
        tft180_write_16bit_data_array(color_buffer, tft180_width_max);
    }
    TFT180_CS(1);
}

//-------------------------------------------------------------------------------------------------------------------
// 函数简介     TFT180 清屏函数
// 参数说明     color           颜色格式 RGB565 或者可以使用 zf_common_font.h 内常用颜色宏定义
// 返回参数     void
// 使用示例     tft180_full(RGB565_YELLOW);
// 备注信息
//-------------------------------------------------------------------------------------------------------------------
void tft180_full (const uint16_t color)
{
    uint16_t color_buffer[160];
    uint16_t i = 0, j = 0;

    TFT180_CS(0);
    tft180_set_region(0, 0, tft180_width_max - 1, tft180_height_max - 1);
    for(i = 0; i < tft180_width_max; i ++)
    {
        color_buffer[i] = color;
    }
    for (j = 0; j < tft180_height_max; j ++)
    {
        tft180_write_16bit_data_array(color_buffer, tft180_width_max);
    }
    TFT180_CS(1);
}

//-------------------------------------------------------------------------------------------------------------------
// 函数简介     设置显示方向
// 参数说明     dir             显示方向  参照 zf_device_ips114.h 内 tft180_dir_enum 枚举体定义
// 返回参数     void
// 使用示例     tft180_set_dir(TFT180_CROSSWISE);
// 备注信息     这个函数只有在初始化屏幕之前调用才生效
//-------------------------------------------------------------------------------------------------------------------
void tft180_set_dir (tft180_dir_enum dir)
{
    tft180_display_dir = dir;
    switch(tft180_display_dir)
    {
        case TFT180_PORTAIT:
        case TFT180_PORTAIT_180:
        {
            tft180_width_max = 128;
            tft180_height_max = 160;
        }break;
        case TFT180_CROSSWISE:
        case TFT180_CROSSWISE_180:
        {
            tft180_width_max = 160;
            tft180_height_max = 128;
        }break;
    }
}

//-------------------------------------------------------------------------------------------------------------------
// 函数简介     设置显示字体
// 参数说明     dir             显示方向  参照 zf_device_tft180.h 内 tft180_font_size_enum 枚举体定义
// 返回参数     void
// 使用示例     tft180_set_font(TFT180_8x16_FONT);
// 备注信息     字体可以随时自由设置 设置后生效 后续显示就是新的字体大小
//-------------------------------------------------------------------------------------------------------------------
void tft180_set_font (tft180_font_size_enum font)
{
    tft180_display_font = font;
}

//-------------------------------------------------------------------------------------------------------------------
// 函数简介     设置显示颜色
// 参数说明     pen             颜色格式 RGB565 或者可以使用 zf_common_font.h 内常用颜色宏定义
// 参数说明     bgcolor         颜色格式 RGB565 或者可以使用 zf_common_font.h 内常用颜色宏定义
// 返回参数     void
// 使用示例     tft180_set_color(RGB565_WHITE, RGB565_BLACK);
// 备注信息     字体颜色和背景颜色也可以随时自由设置 设置后生效
//-------------------------------------------------------------------------------------------------------------------
void tft180_set_color (uint16_t pen, const uint16_t bgcolor)
{
    tft180_pencolor = pen;
    tft180_bgcolor = bgcolor;
}

//-------------------------------------------------------------------------------------------------------------------
// 函数简介     TFT180 画点
// 参数说明     x               坐标x方向的起点 参数范围 [0, tft180_width_max-1]
// 参数说明     y               坐标y方向的起点 参数范围 [0, tft180_height_max-1]
// 参数说明     dat             需要显示的颜色
// 返回参数     void
// 使用示例     tft180_draw_point(0, 0, RGB565_RED);            // 坐标 0,0 画一个红色的点
// 备注信息
//-------------------------------------------------------------------------------------------------------------------
void tft180_draw_point (uint16_t x, uint16_t y, const uint16_t color)
{


    if(x >= tft180_width_max || y >= tft180_height_max){
        return;
    }

    TFT180_CS(0);
    tft180_set_region(x, y, x, y);
    tft180_write_16bit_data(color);
    TFT180_CS(1);
}

//-------------------------------------------------------------------------------------------------------------------
// 函数简介     TFT180 画线
// 参数说明     x_start         坐标x方向的起点
// 参数说明     y_start         坐标y方向的起点
// 参数说明     x_end           坐标x方向的终点
// 参数说明     y_end           坐标y方向的终点
// 参数说明     dat             需要显示的颜色
// 返回参数     void
// 使用示例     tft180_draw_line(0, 0, 10, 10,RGB565_RED);      // 坐标 0,0 到 10,10 画一条红色的线
// 备注信息
//-------------------------------------------------------------------------------------------------------------------
void tft180_draw_line (uint16_t x_start, uint16_t y_start, uint16_t x_end, uint16_t y_end, const uint16_t color)
{


    int16_t x_dir = (x_start < x_end ? 1 : -1);
    int16_t y_dir = (y_start < y_end ? 1 : -1);
    float temp_rate = 0;
    float temp_b = 0;

    do
    {
        if(x_start != x_end)
        {
            temp_rate = (float)(y_start - y_end) / (float)(x_start - x_end);
            temp_b = (float)y_start - (float)x_start * temp_rate;
        }
        else
        {
            while(y_start != y_end)
            {
                tft180_draw_point(x_start, y_start, color);
                y_start += y_dir;
            }
            tft180_draw_point(x_start, y_start, color);
            break;
        }
        
        if(func_abs(y_start - y_end) > func_abs(x_start - x_end))
        {
            while(y_start != y_end)
            {
                tft180_draw_point(x_start, y_start, color);
                y_start += y_dir;
                x_start = (int16_t)(((float)y_start - temp_b) / temp_rate);
            }
            tft180_draw_point(x_start, y_start, color);
        }
        else
        {
            while(x_start != x_end)
            {
                tft180_draw_point(x_start, y_start, color);
                x_start += x_dir;
                y_start = (int16_t)((float)x_start * temp_rate + temp_b);
            }
            tft180_draw_point(x_start, y_start, color);
        }
    }while(0);
}

//-------------------------------------------------------------------------------------------------------------------
// 函数简介     TFT180 显示字符
// 参数说明     x               坐标x方向的起点 参数范围 [0, tft180_width_max-1]
// 参数说明     y               坐标y方向的起点 参数范围 [0, tft180_height_max-1]
// 参数说明     dat             需要显示的字符
// 返回参数     void
// 使用示例     tft180_show_char(0, 0, 'x');                    // 坐标 0,0 写一个字符 x
// 备注信息
//-------------------------------------------------------------------------------------------------------------------
void tft180_show_char (uint16_t x, uint16_t y, const char dat)
{


    uint8_t i = 0, j = 0;

    TFT180_CS(0);
    switch(tft180_display_font)
    {
        case TFT180_6X8_FONT:
        {
            uint16_t display_buffer[6*8];
            tft180_set_region(x, y, x + 5, y + 7);
            for(i = 0; 6 > i; i ++)
            {
                // 减 32 因为是取模是从空格开始取得 空格在 ascii 中序号是 32
                uint8_t temp_top = ascii_font_6x8[dat - 32][i];
                for(j = 0; 8 > j; j ++)
                {
                    if(temp_top & 0x01)
                    {
                        display_buffer[i + j * 6] = (tft180_pencolor);
                    }
                    else
                    {
                        display_buffer[i + j * 6] = (tft180_bgcolor);
                    }
                    temp_top >>= 1;
                }
            }
            tft180_write_16bit_data_array(display_buffer, 6*8);
        }break;
        case TFT180_8X16_FONT:
        {
            uint16_t display_buffer[8*16];
            tft180_set_region(x, y, x + 7, y + 15);
            for(i = 0; 8 > i; i ++)
            {
                uint8_t temp_top = ascii_font_8x16[dat - 32][i];
                uint8_t temp_bottom = ascii_font_8x16[dat - 32][i + 8];
                for(j = 0; 8 > j; j ++)
                {
                    if(temp_top & 0x01)
                    {
                        display_buffer[i + j * 8] = (tft180_pencolor);
                    }
                    else
                    {
                        display_buffer[i + j * 8] = (tft180_bgcolor);
                    }
                    temp_top >>= 1;
                }
                for(j = 0; 8 > j; j ++)
                {
                    if(temp_bottom & 0x01)
                    {
                        display_buffer[i + j * 8 + 4 * 16] = (tft180_pencolor);
                    }
                    else
                    {
                        display_buffer[i + j * 8 + 4 * 16] = (tft180_bgcolor);
                    }
                    temp_bottom >>= 1;
                }
            }
            tft180_write_16bit_data_array(display_buffer, 8 * 16);
        }break;
        case TFT180_16X16_FONT:
        {
            // 暂不支持
        }break;
    }
    TFT180_CS(1);
}

//-------------------------------------------------------------------------------------------------------------------
// 函数简介     TFT180 显示字符串
// 参数说明     x               坐标x方向的起点 参数范围 [0, tft180_width_max-1]
// 参数说明     y               坐标y方向的起点 参数范围 [0, tft180_height_max-1]
// 参数说明     dat             需要显示的字符串
// 返回参数     void
// 使用示例     tft180_show_string(0, 0, "seekfree");
// 备注信息
//-------------------------------------------------------------------------------------------------------------------
void tft180_show_string (uint16_t x, uint16_t y, const char dat[])
{

    
    uint16_t j = 0;
    while('\0' != dat[j])
    {
        switch(tft180_display_font)
        {
            case TFT180_6X8_FONT:   tft180_show_char(x + 6 * j, y, dat[j]); break;
            case TFT180_8X16_FONT:  tft180_show_char(x + 8 * j, y, dat[j]); break;
            case TFT180_16X16_FONT: break;                                      // 暂不支持
        }
        j ++;
    }
}


//-------------------------------------------------------------------------------------------------------------------
// 函数简介     TFT180 初始化
// 返回参数     void
// 返回参数     void
// 使用示例     tft180_init();
// 备注信息
//-------------------------------------------------------------------------------------------------------------------
void tft180_init (void){
    tft180_set_dir(tft180_display_dir);
    tft180_set_color(tft180_pencolor, tft180_bgcolor);

    TFT180_RST(0);
    CN_delay_ms(5);
    TFT180_RST(1);
    CN_delay_ms(120);

    TFT180_CS(0);

    tft180_write_index(0x11);
    CN_delay_ms(120);

    tft180_write_index(0xB1);
    tft180_write_8bit_data(0x01);
    tft180_write_8bit_data(0x2C);
    tft180_write_8bit_data(0x2D);

    tft180_write_index(0xB2);
    tft180_write_8bit_data(0x01);
    tft180_write_8bit_data(0x2C);
    tft180_write_8bit_data(0x2D);

    tft180_write_index(0xB3);
    tft180_write_8bit_data(0x01);
    tft180_write_8bit_data(0x2C);
    tft180_write_8bit_data(0x2D);
    tft180_write_8bit_data(0x01);
    tft180_write_8bit_data(0x2C);
    tft180_write_8bit_data(0x2D);

    tft180_write_index(0xB4);
    tft180_write_8bit_data(0x07);

    tft180_write_index(0xC0);
    tft180_write_8bit_data(0xA2);
    tft180_write_8bit_data(0x02);
    tft180_write_8bit_data(0x84);
    tft180_write_index(0xC1);
    tft180_write_8bit_data(0xC5);

    tft180_write_index(0xC2);
    tft180_write_8bit_data(0x0A);
    tft180_write_8bit_data(0x00);

    tft180_write_index(0xC3);
    tft180_write_8bit_data(0x8A);
    tft180_write_8bit_data(0x2A);
    tft180_write_index(0xC4);
    tft180_write_8bit_data(0x8A);
    tft180_write_8bit_data(0xEE);

    tft180_write_index(0xC5);
    tft180_write_8bit_data(0x0E);

    tft180_write_index(0x36);
    switch(tft180_display_dir)                                                  // y x v
    {
        case TFT180_PORTAIT:        tft180_write_8bit_data(1<<7 | 1<<6 | 0<<5);  break;
        case TFT180_PORTAIT_180:    tft180_write_8bit_data(0<<7 | 0<<6 | 0<<5);  break;
        case TFT180_CROSSWISE:      tft180_write_8bit_data(1<<7 | 0<<6 | 1<<5);  break;
        case TFT180_CROSSWISE_180:  tft180_write_8bit_data(0<<7 | 1<<6 | 1<<5);  break;
    }

    tft180_write_index(0xe0);
    tft180_write_8bit_data(0x0f);
    tft180_write_8bit_data(0x1a);
    tft180_write_8bit_data(0x0f);
    tft180_write_8bit_data(0x18);
    tft180_write_8bit_data(0x2f);
    tft180_write_8bit_data(0x28);
    tft180_write_8bit_data(0x20);
    tft180_write_8bit_data(0x22);
    tft180_write_8bit_data(0x1f);
    tft180_write_8bit_data(0x1b);
    tft180_write_8bit_data(0x23);
    tft180_write_8bit_data(0x37);
    tft180_write_8bit_data(0x00);
    tft180_write_8bit_data(0x07);
    tft180_write_8bit_data(0x02);
    tft180_write_8bit_data(0x10);

    tft180_write_index(0xe1);
    tft180_write_8bit_data(0x0f);
    tft180_write_8bit_data(0x1b);
    tft180_write_8bit_data(0x0f);
    tft180_write_8bit_data(0x17);
    tft180_write_8bit_data(0x33);
    tft180_write_8bit_data(0x2c);
    tft180_write_8bit_data(0x29);
    tft180_write_8bit_data(0x2e);
    tft180_write_8bit_data(0x30);
    tft180_write_8bit_data(0x30);
    tft180_write_8bit_data(0x39);
    tft180_write_8bit_data(0x3f);
    tft180_write_8bit_data(0x00);
    tft180_write_8bit_data(0x07);
    tft180_write_8bit_data(0x03);
    tft180_write_8bit_data(0x10);

    tft180_write_index(0x2a);
    tft180_write_8bit_data(0x00);
    tft180_write_8bit_data(0x00 + 2);
    tft180_write_8bit_data(0x00);
    tft180_write_8bit_data(0x80 + 2);

    tft180_write_index(0x2b);
    tft180_write_8bit_data(0x00);
    tft180_write_8bit_data(0x00 + 3);
    tft180_write_8bit_data(0x00);
    tft180_write_8bit_data(0x80 + 3);

    tft180_write_index(0xF0);
    tft180_write_8bit_data(0x01);
    tft180_write_index(0xF6);
    tft180_write_8bit_data(0x00);

    tft180_write_index(0x3A);
    tft180_write_8bit_data(0x05);
    tft180_write_index(0x29);
    TFT180_CS(1);

    tft180_clear();

    TFT180_BLK(1);  // 打开背光
    for(int y=0; y<50; y++){
        for(int x=0; x<50; x++){
            tft180_draw_point(x, y, 0xF800); 
        }
    }
}



const uint8_t ascii_font_8x16[][16]={
    // <阴码> <列行式> <逆向> <8*16>
    // <纵向 8bit 为一个数据模型> <横向取模>

    // 字模数据储存格式为：{byte1, byte2,....byte16}

    // 字模数据与像素对应关系
    // byte 1      2      3      4      5      6      7      8
    // bit  [  0]  [  8]  [ 16]  [ 24]  [ 32]  [ 40]  [ 48]  [ 56]
    // bit  [  1]  [  9]  [ 17]  [ 25]  [ 33]  [ 41]  [ 49]  [ 57]
    // bit  [  2]  [ 10]  [ 18]  [ 26]  [ 34]  [ 42]  [ 50]  [ 58]
    // bit  [  3]  [ 11]  [ 19]  [ 37]  [ 35]  [ 43]  [ 51]  [ 59]
    // bit  [  4]  [ 12]  [ 20]  [ 38]  [ 36]  [ 44]  [ 52]  [ 60]
    // bit  [  5]  [ 13]  [ 21]  [ 39]  [ 37]  [ 45]  [ 53]  [ 61]
    // bit  [  6]  [ 14]  [ 22]  [ 30]  [ 38]  [ 46]  [ 54]  [ 62]
    // bit  [  7]  [ 15]  [ 23]  [ 31]  [ 39]  [ 47]  [ 55]  [ 63]

    // byte 9      10     11     12     13     14     15     16
    // bit  [ 64]  [ 72]  [ 80]  [ 88]  [ 96]  [104]  [112]  [120]
    // bit  [ 65]  [ 73]  [ 81]  [ 89]  [ 97]  [105]  [113]  [121]
    // bit  [ 66]  [ 74]  [ 82]  [ 90]  [ 98]  [106]  [114]  [122]
    // bit  [ 67]  [ 75]  [ 83]  [ 91]  [ 99]  [107]  [115]  [123]
    // bit  [ 68]  [ 76]  [ 84]  [ 92]  [100]  [108]  [116]  [124]
    // bit  [ 69]  [ 77]  [ 85]  [ 93]  [101]  [109]  [117]  [125]
    // bit  [ 70]  [ 78]  [ 86]  [ 94]  [102]  [110]  [118]  [126]
    // bit  [ 71]  [ 79]  [ 87]  [ 95]  [103]  [111]  [119]  [127]

    {0x00,0x00,0x00,0x00,0x00,0x00,0x00,0x00,0x00,0x00,0x00,0x00,0x00,0x00,0x00,0x00},  //   0
    {0x00,0x00,0x00,0xF8,0x00,0x00,0x00,0x00,0x00,0x00,0x00,0x33,0x30,0x00,0x00,0x00},  // ! 1
    {0x00,0x10,0x0C,0x06,0x10,0x0C,0x06,0x00,0x00,0x00,0x00,0x00,0x00,0x00,0x00,0x00},  // " 2
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    {0x00,0x06,0x01,0x01,0x02,0x02,0x04,0x04,0x00,0x00,0x00,0x00,0x00,0x00,0x00,0x00}   // ~ 94
};

const uint8_t ascii_font_6x8[][6] ={
    // <阴码> <列行式> <逆向> <6*8>
    // <纵向 8bit 为一个数据模型> <横向取模>

    // 字模数据储存格式为：{byte1, byte2,....byte6}

    // 字模数据与像素对应关系
    // byte 1      2      3      4      5      6
    // bit  [  0]  [  8]  [ 16]  [ 24]  [ 32]  [ 40]
    // bit  [  1]  [  9]  [ 17]  [ 25]  [ 33]  [ 41]
    // bit  [  2]  [ 10]  [ 18]  [ 26]  [ 34]  [ 42]
    // bit  [  3]  [ 11]  [ 19]  [ 37]  [ 35]  [ 43]
    // bit  [  4]  [ 12]  [ 20]  [ 38]  [ 36]  [ 44]
    // bit  [  5]  [ 13]  [ 21]  [ 39]  [ 37]  [ 45]
    // bit  [  6]  [ 14]  [ 22]  [ 30]  [ 38]  [ 46]
    // bit  [  7]  [ 15]  [ 23]  [ 31]  [ 39]  [ 47]


    { 0x00, 0x00, 0x00, 0x00, 0x00, 0x00 },     //    0
    { 0x00, 0x00, 0x00, 0x2f, 0x00, 0x00 },     // !  1
    { 0x00, 0x00, 0x07, 0x00, 0x07, 0x00 },     // "  2
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    { 0x14, 0x14, 0x14, 0x14, 0x14, 0x14 }      // horiz lines
};




/******************************************SPI驱动*******************************************/
SPI_HandleTypeDef Hard_SPI_2_Handle={0};

void TS_Hard_SPI_init(void){
    __HAL_RCC_SPI2_CLK_ENABLE(); //使能SPI2时钟
    __HAL_RCC_GPIOD_CLK_ENABLE();
    __HAL_RCC_GPIOG_CLK_ENABLE();
    __HAL_RCC_GPIOI_CLK_ENABLE();

    GPIO_InitTypeDef GPIO_initure={0};

    GPIO_initure.Pin=GPIO_PIN_1 | GPIO_PIN_3;
    GPIO_initure.Mode=GPIO_MODE_AF_PP;
    GPIO_initure.Pull=GPIO_NOPULL;
    GPIO_initure.Speed=GPIO_SPEED_FREQ_VERY_HIGH;
    GPIO_initure.Alternate=GPIO_AF5_SPI2;
    HAL_GPIO_Init(GPIOI,&GPIO_initure);

    GPIO_initure.Pin=GPIO_PIN_2 | GPIO_PIN_3 | GPIO_PIN_4;
    GPIO_initure.Mode=GPIO_MODE_OUTPUT_PP;
    GPIO_initure.Pull=GPIO_PULLUP;
    GPIO_initure.Speed=GPIO_SPEED_FREQ_HIGH;
    HAL_GPIO_Init(GPIOD,&GPIO_initure);

    GPIO_initure.Pin=GPIO_PIN_10;
    HAL_GPIO_Init(GPIOG,&GPIO_initure);

    HAL_GPIO_WritePin(GPIOD,GPIO_PIN_2,GPIO_PIN_SET);

    Hard_SPI_2_Handle.Instance=SPI2;                                  //SPI2
    Hard_SPI_2_Handle.Init.Mode=SPI_MODE_MASTER;                            //SPI：主机模式
    Hard_SPI_2_Handle.Init.Direction=SPI_DIRECTION_1LINE;                   //SPI：单线发送
    Hard_SPI_2_Handle.Init.DataSize=SPI_DATASIZE_8BIT;                      //数据宽度：8bit
    Hard_SPI_2_Handle.Init.CLKPolarity=SPI_POLARITY_LOW;                    //CLK空闲为低
    Hard_SPI_2_Handle.Init.CLKPhase=SPI_PHASE_1EDGE;                        //数据在第一个边沿有效
    Hard_SPI_2_Handle.Init.NSS=SPI_NSS_SOFT;                                //软件片选
    Hard_SPI_2_Handle.Init.BaudRatePrescaler=SPI_BAUDRATEPRESCALER_32;       //二分频，最高频率
    Hard_SPI_2_Handle.Init.FirstBit=SPI_FIRSTBIT_MSB;                       //大端序
    Hard_SPI_2_Handle.Init.TIMode=SPI_TIMODE_DISABLE;                       //禁止TI模式，使用摩托罗拉协议
    Hard_SPI_2_Handle.Init.CRCCalculation=SPI_CRCCALCULATION_DISABLE;       //禁止CRC校验
    Hard_SPI_2_Handle.Init.CRCPolynomial=1;                                 //CRC校验，无效

    HAL_SPI_Init(&Hard_SPI_2_Handle);

    __HAL_SPI_ENABLE(&Hard_SPI_2_Handle); // 先初始化
    __HAL_SPI_DISABLE(&Hard_SPI_2_Handle); // 修改配置前禁用
    SPI_1LINE_TX(&Hard_SPI_2_Handle); // 设置为单线发送
    __HAL_SPI_ENABLE(&Hard_SPI_2_Handle); // 启用 SPI

    // uint32_t spi_freq = HAL_RCCEx_GetPeriphCLKFreq(RCC_PERIPHCLK_SPI2);
    // printf("SPI2 Clock: %lu Hz\n", spi_freq);

}

/******************************************SPI驱动*******************************************/


